ORG 0000H
LJMP MAIN

ORG 000BH
TIMER0_ISR:
	PUSH ACC
	PUSH PSW
	
	MOV A, R4
	ADD A, #-1
	MOV B, #10
	DIV AB
	MOV DPTR, #LED7
	CJNE R5, #0, DIG2
DIG1:
	CLR  P2.2
	MOVC A, @A+DPTR
	MOV  P3, A
	SETB P2.1
	MOV R5, #1
	SJMP TIMER0_ISR_RET
DIG2:
	CLR  P2.1
	MOV  A, B
	MOVC A, @A+DPTR
	MOV  P3, A
	SETB P2.2
	MOV R5, #0
TIMER0_ISR_RET:
	MOV  TH0,  #08AH
	MOV  TL0,  #0D0H
	POP PSW
	POP ACC
	RETI
	
MAIN:
	SETB P1.0	; Den pha re xanh 1,2
	CLR  P1.1	; Den pha re do 3
	CLR  P1.2	; Den pha re xanh 3
	CLR  P1.3	; Den xanh 1
	CLR  P1.4	; Den xanh 2
	CLR  P1.5	; Den vang 1
	CLR  P1.6	; Den vang 2
	CLR  P1.7	; Den do 1
	CLR  P2.0	; Den do 2
	; Enable Timer0 interrupt
	MOV  TMOD, #01H
	MOV  TH0,  #08AH
	MOV  TL0,  #0D0H
	SETB TR0
	MOV  R5, #0
	SETB EA
	SETB ET0
LOOP:
	ACALL STATE1
	ACALL STATE2
	ACALL STATE3
	ACALL STATE2
    SJMP LOOP
STATE1:
	; D1
	SETB P1.3
	CLR  P1.5
	CLR  P1.7
	; D2
	CLR  P1.4
	CLR  P1.6
	SETB P2.0
	; D3
	CLR  P1.1
	SETB P1.2
	MOV R4, #31
	ACALL DELAY
	RET
STATE2:
	; D1
	CLR  P1.3
	SETB P1.5
	CLR  P1.7
	; D2
	CLR  P1.4
	SETB P1.6
	CLR  P2.0
	; D3
	SETB P1.1
	CLR  P1.2
	MOV R4, #4
	ACALL DELAY
	RET
STATE3:
	; D1
	CLR  P1.3
	CLR  P1.5
	SETB P1.7
	; D2
	SETB P1.4
	CLR  P1.6
	CLR  P2.0
	; D3
	SETB P1.1
	CLR  P1.2
	MOV R4, #31
	ACALL DELAY
	RET
DELAY:
	;MOV R4, #1
	LOOP1:
		MOV R3, #10
	LOOP2:
		MOV R2, #250
	LOOP3:
		MOV R1, #200
	LOOP4:
		DJNZ R1, LOOP4
		DJNZ R2, LOOP3
		DJNZ R3, LOOP2
		DJNZ R4, LOOP1
		RET

LED7:
	DB 0C0H, 0F9H, 0A4H, 0B0H, 99H, 92H, 82H, 0F8H, 80H, 90H
END